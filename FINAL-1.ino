#define BLYNK_TEMPLATE_ID "TMPL31ISoTcnH"
#define BLYNK_TEMPLATE_NAME "SMART CRADLE SYSTEM"
#define BLYNK_AUTH_TOKEN "Yr6R_-JYdCcF7ZmYZs5RSv0HX1AB21Ve"
#define BLYNK_PRINT Serial
#include <ESP8266WiFi.h>
#include <BlynkSimpleEsp8266.h>
BlynkTimer timer;

char auth[] = BLYNK_AUTH_TOKEN;
char ssid[] = "T nani";
char pass[] = "TNANI3284";

#include <Servo.h>
#include <LiquidCrystal_I2C.h>
#include <DHT.h>
#define DHT_PIN D5
#define ePin D0
//#define BUZZER_PIN1 D6  
#define BUZZER_PIN2 D7
#define DHTTYPE DHT11
const int servoPin1=D4;
const int ledPin=D3;
const int micPin=A0;
const int micThreshold=100;
int fanPin = D8;
unsigned long startTime=0;
unsigned long elapsedTime=0;
int tempThreshold = 30; 
int frame = 0;
Servo servo1;
Servo servo2;
DHT dht(DHT_PIN, DHTTYPE);
LiquidCrystal_I2C lcd(0x27, 20, 4);
#include <Adafruit_GFX.h>
#include <Adafruit_SSD1306.h>
#define SCREEN_I2C_ADDR 0x3c // or 0x3C
#define SCREEN_WIDTH 128     // OLED display width, in pixels
#define SCREEN_HEIGHT 64     // OLED display height, in pixels
Adafruit_SSD1306 display(128, 64, &Wire);
#define FRAME_DELAY (42)
#define FRAME_WIDTH (48)
#define FRAME_HEIGHT (48)
#define FRAME_COUNT (sizeof(frames) / sizeof(frames[0]))
const byte PROGMEM frames[][288] = {
   {0,0,0,0,0,0,0,124,0,0,62,0,0,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0,0},
  {0,0,0,0,0,0,0,124,0,0,62,0,0,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0,0},
  {0,0,0,0,0,0,0,124,0,0,62,0,0,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0,0},
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  {0,0,0,0,0,0,0,0,0,0,0,0,0,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0,0}
};
void setup() {
  Serial.begin(9600);
  display.begin(SSD1306_SWITCHCAPVCC, SCREEN_I2C_ADDR);
  servo1.attach(servoPin1);
  pinMode(fanPin, OUTPUT);
  pinMode(ePin, OUTPUT);
 // pinMode(BUZZER_PIN1, OUTPUT);
 pinMode(BUZZER_PIN2, OUTPUT);
  pinMode(ledPin, OUTPUT);
  Serial.begin(9600);
  Blynk.begin(auth,ssid,pass);
  dht.begin();
  lcd.init();
  lcd.backlight();
  lcd.setCursor(4, 1); 
  lcd.print("SMART CRADLE");
  delay(2000); 
}
void loop() {
  int micValue = analogRead(micPin);
  if(startTime==0){
   startTime=millis();
  }
  display.clearDisplay();
  display.drawBitmap(40, 8, frames[frame], FRAME_WIDTH, FRAME_HEIGHT, 1);
  display.display();
  frame = (frame + 20) % FRAME_COUNT;
  lcd.clear();  
  int temperature = dht.readTemperature();
  int humidity = dht.readHumidity();
  lcd.setCursor(2, 0); 
  lcd.print("TEM:"); 
  lcd.print(temperature);
  Blynk.virtualWrite(V0,temperature); 
  lcd.print("C"); 
  lcd.print(" HUM:"); 
  lcd.print(humidity);
  Blynk.virtualWrite(V1,humidity); 
  lcd.print("%"); 
  if (temperature >= tempThreshold) {
    digitalWrite(fanPin, HIGH);
   // delay(1000);
  } else {
    digitalWrite(fanPin, LOW);
  }
  if (micValue>=micThreshold){ 
    elapsedTime=millis()-startTime;
  } else{
   elapsedTime=0;
   startTime=millis();
  }
    if (elapsedTime >= 2000 && elapsedTime < 10000) {
     case1();
    } else if (elapsedTime >= 10000 && elapsedTime < 20000) {
     digitalWrite(ePin, HIGH);
     case2();
     digitalWrite(ePin, LOW);
    } else if (elapsedTime >= 20000) {
     case3();
    } else{
      case4();
    }
  Serial.print("temp:");
  Serial.print(temperature);
  Serial.println("C");
  Serial.print("hum:");
  Serial.print(humidity);
  Serial.println("%");
  Serial.println(micValue);
  timer.run();  // Initiates SimpleTimer
  Blynk.run();
}

void case1(void) {
  lcd.setCursor(2, 2);
  lcd.print("CRADLE IS MOVING");
  servo1.write(0);
  delay(1000);
  servo1.write(180);
  Serial.println("CRADLE IS MOVING");
  Blynk.virtualWrite(V3,"CRADLE IS MOVING");
}

void case2(void) {
  lcd.setCursor(3, 2); 
  lcd.print("PLAYING RHYMES");
  servo1.write(0);
  delay(1000);
  servo1.write(180);
  Serial.println("PLAYING RHYMES");
  Blynk.virtualWrite(V3,"PLAYING RHYMES");
}

void case3(void) {
  Blynk.logEvent("take_care");
  lcd.setCursor(1, 2); 
  lcd.print("TAKE CARE OF BABY");
  delay(1000);
  Serial.println("TAKE CARE OF BABY");
  Blynk.virtualWrite(V3,"TAKE CARE OF BABY");
  digitalWrite(ledPin, HIGH);
  digitalWrite(BUZZER_PIN2, HIGH);
  delay(1000);
  digitalWrite(ledPin, LOW);
  digitalWrite(BUZZER_PIN2, LOW);
}
void case4(void) {
  servo1.write(90);
  lcd.setCursor(2, 2);
  lcd.print("BABY IS SLEEPING");
  Serial.println("BABY IS SLEEPING");
  Blynk.virtualWrite(V2,"BABY IS SLEEPING");
  delay(1000);
}
